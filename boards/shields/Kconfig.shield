## boards/shields/Kconfig.shield
```kconfig
config SHIELD_ERGO_WIRELESS
    def_bool $(shields_list_contains, ergo_wireless)
```

## boards/shields/ergo_wireless/Kconfig.defconfig
```kconfig
if SHIELD_ERGO_WIRELESS_LEFT || SHIELD_ERGO_WIRELESS_RIGHT

config ZMK_SPLIT
    default y

endif
```

## boards/shields/ergo_wireless/Kconfig.shield
```kconfig
config SHIELD_ERGO_WIRELESS_LEFT
    def_bool $(shields_list_contains,ergo_wireless_left)

config SHIELD_ERGO_WIRELESS_RIGHT
    def_bool $(shields_list_contains,ergo_wireless_right)

config SHIELD_DONGLE_DISPLAY
    def_bool $(shields_list_contains,dongle_display)
```

## config/Kconfig.defconfig
```kconfig
if SHIELD_ERGO_WIRELESS

config ZMK_KEYBOARD_NAME
    default "ergo_wireless"

endif
```
