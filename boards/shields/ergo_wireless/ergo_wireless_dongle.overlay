#include <dt-bindings/zmk/matrix_transform.h>
#include "ergo_wireless.dtsi"


&physical_layout0 {
    transform = <&default_transform>;
};

/ {    chosen {
        zmk,kscan = &mock_kscan;
        zmk,physical-layout = &physical_layout0;
    };


    mock_kscan: mock_kscan0 {
        compatible = "zmk,kscan0";
        columns = <0>;
        rows = <0>;
        events = <0>;
    };

};
